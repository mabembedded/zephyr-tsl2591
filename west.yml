## west.yml
```yaml
manifest:
  defaults:
    remote: mab
    revision: main

  remotes:
    - name: mab
      url-base: https://github.com/mabembedded/

  projects:
    - name: zephyr
      revision: v3.4.0
      import: true
```
